## Boards/kamoamoa/cpap_pi_control/board.yml
```yaml
board:
  name: cpap_pi_control
  full_name: CPAP PI Control Board
  vendor: kamoamoa
  socs:
    - name: nrf52840

runners:
  run_once:
    '--recover':
      - runners:
          - nrfutil
        run: first
        groups:
          - boards:
              - cpap_pi_control/nrf52840
    '--erase':
      - runners:
          - jlink
          - nrfutil
        run: first
        groups:
          - boards:
              - cpap_pi_control/nrf52840
    '--reset':
      - runners:
          - jlink
          - nrfutil
        run: last
        groups:
          - boards:
              - cpap_pi_control/nrf52840
```

## Boards/kamoamoa/kmm_pmask_control/Kconfig.kmm_pmask_control
```kconfig
config BOARD_KMM_PMASK_CONTROL
	select SOC_NRF52840_QIAA if BOARD_KMM_PMASK_CONTROL_NRF52840
```

## Boards/kamoamoa/kmm_pmask_control/board.yml
```yaml
board:
  name: kmm_pmask_control
  full_name: KMM PMask Control Board
  vendor: kamoamoa
  socs:
    - name: nrf52840

runners:
  run_once:
    '--recover':
      - runners:
          - nrfutil
        run: first
        groups:
          - boards:
              - kmm_pmask_control/nrf52840
    '--erase':
      - runners:
          - jlink
          - nrfutil
        run: first
        groups:
          - boards:
              - kmm_pmask_control/nrf52840
    '--reset':
      - runners:
          - jlink
          - nrfutil
        run: last
        groups:
          - boards:
              - kmm_pmask_control/nrf52840
```
